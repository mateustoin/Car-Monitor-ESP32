## components/board_api/Kconfig
```kconfig
menu "Placa"

    choice BOARD
        prompt "Placa (BSP)"
        default BOARD_M5STICKC_PLUS2 if IDF_TARGET_ESP32
        default BOARD_HEADLESS
        help
            Escolhe o BSP que implementa board_api.h.

        config BOARD_M5STICKC_PLUS2
            bool "M5StickC Plus2 (LCD ST7789, buzzer, 3 botões)"
            depends on IDF_TARGET_ESP32

        config BOARD_HEADLESS
            bool "Headless (sem tela, sem buzzer; só log)"
    endchoice

endmenu
```

## components/bsp_m5stickc_plus2/Kconfig
```kconfig
menu "M5StickC Plus2"
    depends on BOARD_M5STICKC_PLUS2

    # Valores de memória: conferir no esquemático M5Stack.
    config BSP_PLUS2_LCD_GAP_X
        int "Deslocamento X do LCD em paisagem (gap)"
        range 0 80
        default 40

    config BSP_PLUS2_LCD_GAP_Y
        int "Deslocamento Y do LCD em paisagem (gap)"
        range 0 80
        default 53

    config BSP_PLUS2_LCD_INVERT
        bool "Inverter cores do LCD"
        default y

    config BSP_PLUS2_LCD_SWAP_XY
        bool "Trocar X/Y (paisagem)"
        default y

    config BSP_PLUS2_LCD_MIRROR_X
        bool "Espelhar X"
        default y

    config BSP_PLUS2_LCD_MIRROR_Y
        bool "Espelhar Y"
        default n

    config BSP_PLUS2_LCD_BGR
        bool "Ordem de cores BGR (em vez de RGB)"
        default n

    # Pinos: valores de memória, conferir no esquemático M5Stack.
    config BSP_PLUS2_PIN_LCD_MOSI
        int "Pino: LCD MOSI"
        range 0 39
        default 15

    config BSP_PLUS2_PIN_LCD_SCLK
        int "Pino: LCD SCLK"
        range 0 39
        default 13

    config BSP_PLUS2_PIN_LCD_DC
        int "Pino: LCD DC"
        range 0 39
        default 14

    config BSP_PLUS2_PIN_LCD_RST
        int "Pino: LCD RST"
        range 0 39
        default 12

    config BSP_PLUS2_PIN_LCD_CS
        int "Pino: LCD CS"
        range 0 39
        default 5

    config BSP_PLUS2_PIN_LCD_BL
        int "Pino: LCD backlight"
        range 0 39
        default 27

    config BSP_PLUS2_PIN_BUZZER
        int "Pino: Buzzer (LEDC)"
        range 0 39
        default 2

    config BSP_PLUS2_PIN_BTN_A
        int "Pino: Botão A (precisa ser GPIO RTC: despertar ext0)"
        range 0 39
        default 37

    config BSP_PLUS2_PIN_BTN_B
        int "Pino: Botão B"
        range 0 39
        default 39

    config BSP_PLUS2_PIN_BTN_PWR
        int "Pino: Botão PWR/C"
        range 0 39
        default 35

    config BSP_PLUS2_PIN_HOLD
        int "Pino: Trava de energia HOLD (precisa ser GPIO RTC: hold no sono profundo)"
        range 0 39
        default 4

endmenu
```

## components/obd_poller/Kconfig
```kconfig
menu "OBD poller"

    config OBD_POLL_EXTENDED
        bool "Gravação estendida: pedir também MAP (0x0B) e IAT (0x0F)"
        default n
        help
            Agenda MAP e IAT como itens lentos (1 s), para gravar dados da Etapa 2
            (consumo por speed-density). Desligado por padrão: num ELM lento ou em
            K-line cada pedido extra alonga o ciclo de RPM/velocidade de que a marcha
            depende. O componente obd_poller não lê o Kconfig; o app passa a opção
            para obd_poller_init.

endmenu
```

## components/obd_transport/Kconfig
```kconfig
menu "OBD transporte"

    config OBD_TRANSPORT_BT_SPP
        bool "Transporte Bluetooth clássico (SPP) para o ELM327"
        default y
        depends on SOC_BT_CLASSIC_SUPPORTED && BT_BLUEDROID_ENABLED && BT_CLASSIC_ENABLED && BT_SPP_ENABLED

    config OBD_ELM_BT_NAME
        string "Nome Bluetooth do adaptador ELM327"
        default "OBDII"

    config OBD_ELM_BT_PIN
        string "PIN de pareamento do adaptador ELM327"
        default "1234"

endmenu
```

## main/Kconfig.projbuild
```kconfig
menu "Car Monitor (app)"

    config APP_PROFILE_ID
        string "Perfil de veículo padrão"
        default "sandero_k7m"
        help
            Id do perfil (components/vehicle_profile/profiles). Um perfil gravado no NVS
            (storage_set_profile_id) tem prioridade; id desconhecido cai no perfil padrão.

    config APP_POWER_IDLE_MS_OVERRIDE
        int "Ociosidade até o sono profundo, em ms (0 = padrão de 5 min)"
        range 0 3600000
        default 0
        help
            debug: encurta o tempo ocioso (motor parado e ELM sem dados) antes de dormir,
            para testar o sono profundo sem esperar 5 min. Deixe 0 no uso normal.

    config APP_REC_AUTOSTART
        bool "Gravar a viagem na flash automaticamente"
        default n
        help
            Sem notebook no carro: a cada boot, a gravação na flash (como "rec on flash")
            começa sozinha na primeira leitura de RPM > 0. Para no "rec off" ou antes do sono
            profundo; o próximo boot cria outra viagem. Exportar depois pelo console com
            "rec ls" e "rec dump <n>"; apagar com "rec clear". Com a flash cheia a gravação
            para (as viagens antigas ficam).

endmenu
```
